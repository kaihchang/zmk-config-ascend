## boards/shields/ascend/Kconfig.shield
```kconfig
config SHIELD_ASCEND_LEFT
    def_bool $(shields_list_contains,ascend_left)

config SHIELD_ASCEND_RIGHT
    def_bool $(shields_list_contains,ascend_right)
```
