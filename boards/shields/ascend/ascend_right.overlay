#include "ascend.dtsi"

&default_transform { // The matrix transform for this board is 5 columns over because the left half is 5 columns wide according to the matrix.
    col-offset = <5>;
};

&kscan0 {
    col-gpios
        = <&gpio0 24 GPIO_ACTIVE_HIGH> // Col 0_r
        , <&gpio1 0 GPIO_ACTIVE_HIGH> // Col 1_r
        , <&gpio0 11 GPIO_ACTIVE_HIGH> // Col 2_r
        , <&gpio1 4 GPIO_ACTIVE_HIGH> // Col 3_r
        , <&gpio1 6 GPIO_ACTIVE_HIGH>  // Col 4_r
        ;
};

&left_encoder {
    status = "okay";
};